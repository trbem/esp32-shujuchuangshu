## main/Kconfig.projbuild
```kconfig
menu "Sensor Dashboard Configuration"

    config SENSOR_DASH_WIFI_SSID
        string "Wi-Fi SSID (2.4 GHz only)"
        default "YOUR_2.4G_SSID"
        help
            ESP32-S3 has no 5 GHz radio - the AP must be available on 2.4 GHz.
            Set it with `idf.py menuconfig` or in your (git-ignored) sdkconfig.
            Never commit real credentials: sdkconfig is excluded via .gitignore.

    config SENSOR_DASH_WIFI_PASSWORD
        string "Wi-Fi password"
        default "YOUR_WIFI_PASSWORD"

    config SENSOR_DASH_INTERVAL_MS
        int "Sampling / report interval (ms)"
        default 500
        help
            How often the board prints one JSON line with the sensor readings.

    config SENSOR_DASH_COLLECTOR_URL
        string "Telemetry collector URL"
        default "http://192.168.1.100:8080/api/v1/telemetry"
        help
            Set this to the LAN address of the computer running the telemetry server.

    config SENSOR_DASH_COLLECTOR_API_KEY
        string "Telemetry collector API key"
        default "CHANGE_ME"
        help
            Must match TELEMETRY_API_KEY in the computer server's .env file.
            Keep the real value in git-ignored sdkconfig.

    config SENSOR_DASH_DEVICE_ID
        string "Telemetry device ID"
        default "s3eye-001"

    config SENSOR_DASH_UPLOAD_INTERVAL_MS
        int "Telemetry upload interval (ms)"
        default 5000
        range 1000 3600000
        help
            A current sensor snapshot is appended to Flash and uploaded at this interval.

    config SENSOR_DASH_LIVE_UPLOAD_INTERVAL_MS
        int "Live telemetry upload interval (ms)"
        default 1000
        range 500 60000
        help
            How often the current temperature and IMU snapshot is sent to the
            server's volatile live channel.  Live samples update the web page
            but are not written to the 30-day SQLite history or Flash queue.
            The durable telemetry upload interval above remains unchanged.

    config SENSOR_DASH_TASK_POLL_INTERVAL_MS
        int "On-demand capture task poll interval (ms)"
        default 1000
        range 500 10000
        help
            How often the board asks the collector for a capture_full_snapshot task.
            This continues even when the server pauses periodic telemetry storage.

endmenu
```
